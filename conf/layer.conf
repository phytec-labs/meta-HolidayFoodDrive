## conf/layer.conf
```bitbake
# We have a conf and classes directory, add to BBPATH
BBPATH .= ":${LAYERDIR}"

# We have recipes-* directories, add to BBFILES
BBFILES += "${LAYERDIR}/recipes-*/*/*.bb \
            ${LAYERDIR}/recipes-*/*/*.bbappend"

BBFILE_COLLECTIONS += "meta-HolidayFoodDrive"
BBFILE_PATTERN_meta-HolidayFoodDrive = "^${LAYERDIR}/"
BBFILE_PRIORITY_meta-HolidayFoodDrive = "6"

LAYERDEPENDS_meta-HolidayFoodDrive = "core"
LAYERSERIES_COMPAT_meta-HolidayFoodDrive = "kirkstone"

BBFILES += "${@' '.join('${LAYERDIR}/dynamic-layers/%s/recipes*/*/*.bbappend' % layer \
               for layer in BBFILE_COLLECTIONS.split())}"
#BBFILES_DYNAMIC += " \
#	${LAYERDIR}/dynamic-layers/meta-ti-bsp/recipes-*/*/*.bb \
#	${LAYERDIR}/dynamic-layers/meta-ti-bsp/recipes-*/*/*.bbappend
```
